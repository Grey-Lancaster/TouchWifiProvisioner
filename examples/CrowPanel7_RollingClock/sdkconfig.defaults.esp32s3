## examples/CrowPanel7_RollingClock/sdkconfig.defaults.esp32s3
```kconfig
# Enable PSRAM at 120MHz
CONFIG_SPIRAM=y
CONFIG_SPIRAM_MODE_OCT=y
CONFIG_IDF_EXPERIMENTAL_FEATURES=y
CONFIG_SPIRAM_SPEED_120M=y
CONFIG_SPIRAM_FETCH_INSTRUCTIONS=y
CONFIG_SPIRAM_RODATA=y

# Helps raise PCLK frequency when the framebuffer is allocated from PSRAM and pulled by EDMA
CONFIG_FREERTOS_HZ=1000
CONFIG_ESP_DEFAULT_CPU_FREQ_MHZ_240=y
CONFIG_ESPTOOLPY_FLASHMODE_QIO=y
CONFIG_ESPTOOLPY_FLASHFREQ_120M=y
CONFIG_ESPTOOLPY_FLASHSIZE_16MB=y
CONFIG_ESP32S3_DATA_CACHE_LINE_32B=y
CONFIG_COMPILER_OPTIMIZATION_PERF=y

# Use partitions.csv
CONFIG_PARTITION_TABLE_CUSTOM=y
CONFIG_PARTITION_TABLE_CUSTOM_FILENAME="partitions.csv"
CONFIG_PARTITION_TABLE_FILENAME="partitions.csv"

# Anti-tearing
CONFIG_EXAMPLE_LVGL_PORT_AVOID_TEAR_ENABLE=y
```
